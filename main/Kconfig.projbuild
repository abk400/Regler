## main/Kconfig.projbuild
```kconfig
menu "Regler Configuration"

menu "LED channels"
config LED1_FREQ
    int "LED1 frequency"
	range 30000 58000
	default 36000
	help
		LED1 frequency, Hz

config LED2_FREQ
    int "LED2 frequency"
	range 30000 58000
	default 36000
	help
		LED2 frequency, Hz
endmenu

menu "Barrier Speaker"
config SPEAKER_FREQ
    int "Speaker signal frequency"
	range 10 20000
	default 1000
	help
		Barrier speaker frequency, Hz

config SPEAKER_TIMEOUT
    int "Speaker signal timout"
	range 1 120
	default 60
	help
		Barrier speaker timeout, seconds

config PIPKA_TIMEOUT
    int "Pipka signal timout"
	range 100 500
	default 200
	help
		Pipka timeout, milliseconds
endmenu

endmenu
```

## sdkconfig.defaults
```kconfig
CONFIG_ESPTOOLPY_FLASHSIZE_2MB=
CONFIG_ESPTOOLPY_FLASHSIZE_8MB=y
CONFIG_ESPTOOLPY_FLASHSIZE="8MB"
#
CONFIG_CXX_EXCEPTIONS=y
CONFIG_CXX_EXCEPTIONS_EMG_POOL_SIZE=0
#
CONFIG_MAIN_TASK_STACK_SIZE=5584
#
CONFIG_EMAC_L2_TO_L3_RX_BUF_MODE=
#
CONFIG_FREERTOS_USE_TRACE_FACILITY=y
CONFIG_FREERTOS_USE_STATS_FORMATTING_FUNCTIONS=y
CONFIG_FREERTOS_VTASKLIST_INCLUDE_COREID=y
#
CONFIG_MBEDTLS_PSK_MODES=y
CONFIG_MBEDTLS_KEY_EXCHANGE_PSK=
CONFIG_MBEDTLS_KEY_EXCHANGE_DHE_PSK=y
CONFIG_MBEDTLS_KEY_EXCHANGE_ECDHE_PSK=y
CONFIG_MBEDTLS_KEY_EXCHANGE_RSA_PSK=y
#
CONFIG_FREERTOS_HZ=1000
```
